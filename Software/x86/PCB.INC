	PCB_EOI EQU			PCB_BASE+02H
	PCB_POLL EQU		PCB_BASE+04H
	PCB_POLLSTS EQU		PCB_BASE+06H
	PCB_IMASK EQU		PCB_BASE+08H
	PCB_PRIMSK EQU		PCB_BASE+0AH
	PCB_INSERV EQU		PCB_BASE+0CH
	PCB_REQST EQU		PCB_BASE+0EH
	PCB_INSTS EQU		PCB_BASE+010H
	PCB_TCUCON EQU		PCB_BASE+012H
	PCB_SCUCON EQU		PCB_BASE+014H
	PCB_I4CON EQU		PCB_BASE+016H
	PCB_I0CON EQU		PCB_BASE+018H
	PCB_I1CON EQU		PCB_BASE+01AH
	PCB_I2CON EQU		PCB_BASE+01CH
	PCB_I3CON EQU		PCB_BASE+01EH
	PCB_T0CNT EQU		PCB_BASE+030H
	PCB_T0CMPA EQU		PCB_BASE+032H
	PCB_T0CMPB EQU		PCB_BASE+034H
	PCB_T0CON EQU		PCB_BASE+036H
	PCB_T1CNT EQU		PCB_BASE+038H
	PCB_T1CMPA EQU		PCB_BASE+03AH
	PCB_T1CMPB EQU		PCB_BASE+03CH
	PCB_T1CON EQU		PCB_BASE+03EH
	PCB_T2CNT EQU		PCB_BASE+040H
	PCB_T2CMPA EQU		PCB_BASE+042H
	PCB_T2CON EQU		PCB_BASE+046H
	PCB_P1DIR EQU		PCB_BASE+050H
	PCB_P1PIN EQU		PCB_BASE+052H
	PCB_P1CON EQU		PCB_BASE+054H
	PCB_P1LTCH EQU		PCB_BASE+056H
	PCB_P2DIR EQU		PCB_BASE+058H
	PCB_P2PIN EQU		PCB_BASE+05AH
	PCB_P2CON EQU		PCB_BASE+05CH
	PCB_P2LTCH EQU		PCB_BASE+05EH
	PCB_B0CMP EQU		PCB_BASE+060H
	PCB_B0CNT EQU		PCB_BASE+062H
	PCB_S0CON EQU		PCB_BASE+064H
	PCB_S0STS EQU		PCB_BASE+066H
	PCB_S0RBUF EQU		PCB_BASE+068H
	PCB_S0TBUF EQU		PCB_BASE+06AH
	PCB_B1CMP EQU		PCB_BASE+070H
	PCB_B1CNT EQU		PCB_BASE+072H
	PCB_S1CON EQU		PCB_BASE+074H
	PCB_S1STS EQU		PCB_BASE+076H
	PCB_S1RBUF EQU		PCB_BASE+078H
	PCB_S1TBUF EQU		PCB_BASE+07AH
	PCB_GCS0ST EQU		PCB_BASE+080H
	PCB_GCS0SP EQU		PCB_BASE+082H
	PCB_GCS1ST EQU		PCB_BASE+084H
	PCB_GCS1SP EQU		PCB_BASE+086H
	PCB_GCS2ST EQU		PCB_BASE+088H
	PCB_GCS2SP EQU		PCB_BASE+08AH
	PCB_GCS3ST EQU		PCB_BASE+08CH
	PCB_GCS3SP EQU		PCB_BASE+08EH
	PCB_GCS4ST EQU		PCB_BASE+090H
	PCB_GCS4SP EQU		PCB_BASE+092H
	PCB_GCS5ST EQU		PCB_BASE+094H
	PCB_GCS5SP EQU		PCB_BASE+096H
	PCB_GCS6ST EQU		PCB_BASE+098H
	PCB_GCS6SP EQU		PCB_BASE+09AH
	PCB_GCS7ST EQU		PCB_BASE+09CH
	PCB_GCS7SP EQU		PCB_BASE+09EH
	PCB_LCSST EQU		PCB_BASE+0A0H
	PCB_LCSSP EQU		PCB_BASE+0A2H
	PCB_UCSST EQU		PCB_BASE+0A4H
	PCB_UCSSP EQU		PCB_BASE+0A6H
	PCB_RELREG EQU		PCB_BASE+0A8H
	PCB_RFBASE EQU		PCB_BASE+0B0H
	PCB_RFTIME EQU		PCB_BASE+0B2H
	PCB_RFCON EQU		PCB_BASE+0B4H
	PCB_RFADDR EQU		PCB_BASE+0B6H
	PCB_PWRCON EQU		PCB_BASE+0B8H
	PCB_STEPID EQU		PCB_BASE+0BCH